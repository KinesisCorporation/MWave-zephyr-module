/ {

    ansi_transform: keymap_transform_0 {
    compatible = "zmk,matrix-transform";
    columns = <32>;
    rows = <18>;
    map = <
      RC(0,0) RC(0,1) RC(0,2) RC(0,3) RC(0,4) RC(0,5) RC(0,6)      RC(0,7) RC(1,8) RC(0,8) RC(0,9) RC(0,10) RC(0,11) RC(0,12) RC(0,13) RC(0,15) RC(0,16)
      RC(1,0) RC(1,1) RC(1,2) RC(1,3) RC(1,4) RC(1,5) RC(1,6)      RC(1,7)    RC(1,9) RC(1,10) RC(1,11) RC(1,12) RC(1,13)        RC(0,14)
      RC(2,0)    RC(2,1) RC(2,2) RC(2,3) RC(2,4)      RC(2,6)      RC(2,7)   RC(2,8) RC(2,9) RC(2,10) RC(2,11) RC(2,12) RC(2,13)    RC(2,14)    RC(2,16)
      RC(3,0)     RC(3,1) RC(3,2) RC(3,3) RC(3,4)     RC(3,6)      RC(3,7)     RC(3,8) RC(3,9) RC(3,10) RC(3,11)      RC(3,12)   RC(4,13)       RC(4,16)
      RC(5,1)         RC(4,1) RC(4,2) RC(4,3) RC(4,4) RC(4,6)      RC(4,7)        RC(4,8) RC(4,9) RC(4,10)  RC(4,11)       RC(4,12)    RC(4,14) RC(4,15)
      RC(5,0)    RC(5,2)   RC(5,3)                    RC(5,6)      RC(5,7)                        RC(5,11)  RC(5,10)  RC(5,14) RC(5,9) RC(5,15) RC(5,16) RC(3,16)
      RC(6,0) RC(6,1) RC(6,2) RC(6,3) RC(6,4) RC(6,5) RC(6,6) RC(6,7) RC(6,8) RC(6,9) RC(6,10) RC(6,11) RC(6,12) RC(6,13) RC(6,14) RC(6,15) RC(6,16) RC(6,17) RC(6,18) RC(6,19) RC(6,20) RC(6,21) RC(6,22) RC(6,23) RC(6,24) RC(6,25) RC(6,26) RC(6,27) RC(6,28) RC(6,29) RC(6,30) RC(6,31) 
RC(7,0) RC(7,1) RC(7,2) RC(7,3) RC(7,4) RC(7,5) RC(7,6) RC(7,7) RC(7,8) RC(7,9) RC(7,10) RC(7,11) RC(7,12) RC(7,13) RC(7,14) RC(7,15) RC(7,16) RC(7,17) RC(7,18) RC(7,19) RC(7,20) RC(7,21) RC(7,22) RC(7,23) RC(7,24) RC(7,25) RC(7,26) RC(7,27) RC(7,28) RC(7,29) RC(7,30) RC(7,31) 
RC(8,0) RC(8,1) RC(8,2) RC(8,3) RC(8,4) RC(8,5) RC(8,6) RC(8,7) RC(8,8) RC(8,9) RC(8,10) RC(8,11) RC(8,12) RC(8,13) RC(8,14) RC(8,15) RC(8,16) RC(8,17) RC(8,18) RC(8,19) RC(8,20) RC(8,21) RC(8,22) RC(8,23) RC(8,24) RC(8,25) RC(8,26) RC(8,27) RC(8,28) RC(8,29) RC(8,30) RC(8,31) 
RC(9,0) RC(9,1) RC(9,2) RC(9,3) RC(9,4) RC(9,5) RC(9,6) RC(9,7) RC(9,8) RC(9,9) RC(9,10) RC(9,11) RC(9,12) RC(9,13) RC(9,14) RC(9,15) RC(9,16) RC(9,17) RC(9,18) RC(9,19) RC(9,20) RC(9,21) RC(9,22) RC(9,23) RC(9,24) RC(9,25) RC(9,26) RC(9,27) RC(9,28) RC(9,29) RC(9,30) RC(9,31) 
RC(10,0) RC(10,1) RC(10,2) RC(10,3) RC(10,4) RC(10,5) RC(10,6) RC(10,7) RC(10,8) RC(10,9) RC(10,10) RC(10,11) RC(10,12) RC(10,13) RC(10,14) RC(10,15) RC(10,16) RC(10,17) RC(10,18) RC(10,19) RC(10,20) RC(10,21) RC(10,22) RC(10,23) RC(10,24) RC(10,25) RC(10,26) RC(10,27) RC(10,28) RC(10,29) RC(10,30) RC(10,31) 
RC(11,0) RC(11,1) RC(11,2) RC(11,3) RC(11,4) RC(11,5) RC(11,6) RC(11,7) RC(11,8) RC(11,9) RC(11,10) RC(11,11) RC(11,12) RC(11,13) RC(11,14) RC(11,15) RC(11,16) RC(11,17) RC(11,18) RC(11,19) RC(11,20) RC(11,21) RC(11,22) RC(11,23) RC(11,24) RC(11,25) RC(11,26) RC(11,27) RC(11,28) RC(11,29) RC(11,30) RC(11,31) 
RC(12,0) RC(12,1) RC(12,2) RC(12,3) RC(12,4) RC(12,5) RC(12,6) RC(12,7) RC(12,8) RC(12,9) RC(12,10) RC(12,11) RC(12,12) RC(12,13) RC(12,14) RC(12,15) RC(12,16) RC(12,17) RC(12,18) RC(12,19) RC(12,20) RC(12,21) RC(12,22) RC(12,23) RC(12,24) RC(12,25) RC(12,26) RC(12,27) RC(12,28) RC(12,29) RC(12,30) RC(12,31) 
RC(13,0) RC(13,1) RC(13,2) RC(13,3) RC(13,4) RC(13,5) RC(13,6) RC(13,7) RC(13,8) RC(13,9) RC(13,10) RC(13,11) RC(13,12) RC(13,13) RC(13,14) RC(13,15) RC(13,16) RC(13,17) RC(13,18) RC(13,19) RC(13,20) RC(13,21) RC(13,22) RC(13,23) RC(13,24) RC(13,25) RC(13,26) RC(13,27) RC(13,28) RC(13,29) RC(13,30) RC(13,31) 
RC(14,0) RC(14,1) RC(14,2) RC(14,3) RC(14,4) RC(14,5) RC(14,6) RC(14,7) RC(14,8) RC(14,9) RC(14,10) RC(14,11) RC(14,12) RC(14,13) RC(14,14) RC(14,15) RC(14,16) RC(14,17) RC(14,18) RC(14,19) RC(14,20) RC(14,21) RC(14,22) RC(14,23) RC(14,24) RC(14,25) RC(14,26) RC(14,27) RC(14,28) RC(14,29) RC(14,30) RC(14,31) 
RC(15,0) RC(15,1) RC(15,2) RC(15,3) RC(15,4) RC(15,5) RC(15,6) RC(15,7) RC(15,8) RC(15,9) RC(15,10) RC(15,11) RC(15,12) RC(15,13) RC(15,14) RC(15,15) RC(15,16) RC(15,17) RC(15,18) RC(15,19) RC(15,20) RC(15,21) RC(15,22) RC(15,23) RC(15,24) RC(15,25) RC(15,26) RC(15,27) RC(15,28) RC(15,29) RC(15,30) RC(15,31) 
RC(16,0) RC(16,1) RC(16,2) RC(16,3) RC(16,4) RC(16,5) RC(16,6) RC(16,7) RC(16,8) RC(16,9) RC(16,10) RC(16,11) RC(16,12) RC(16,13) RC(16,14) RC(16,15) RC(16,16) RC(16,17) RC(16,18) RC(16,19) RC(16,20) RC(16,21) RC(16,22) RC(16,23) RC(16,24) RC(16,25) RC(16,26) RC(16,27) RC(16,28) RC(16,29) RC(16,30) RC(16,31) 
RC(17,0) RC(17,1) RC(17,2) RC(17,3) RC(17,4) RC(17,5) RC(17,6) RC(17,7) RC(17,8) RC(17,9) RC(17,10) RC(17,11) RC(17,12) RC(17,13) RC(17,14) RC(17,15) RC(17,16) RC(17,17) RC(17,18) RC(17,19) RC(17,20) RC(17,21) RC(17,22) RC(17,23) RC(17,24) RC(17,25) RC(17,26) RC(17,27) RC(17,28) RC(17,29) RC(17,30) RC(17,31) 


    >;
  };
  iso_transform: keymap_transform_1 {
    compatible = "zmk,matrix-transform";
    columns = <32>;
    rows = <18>;
    map = <
      RC(0,0) RC(0,1) RC(0,2) RC(0,3) RC(0,4) RC(0,5) RC(0,6)      RC(0,7) RC(1,8) RC(0,8) RC(0,9) RC(0,10) RC(0,11) RC(0,12) RC(0,13) RC(0,15) RC(0,16)
      RC(1,0) RC(1,1) RC(1,2) RC(1,3) RC(1,4) RC(1,5) RC(1,6)      RC(1,7)    RC(1,9) RC(1,10) RC(1,11) RC(1,12) RC(1,13)        RC(0,14)
      RC(2,0)    RC(2,1) RC(2,2) RC(2,3) RC(2,4)      RC(2,6)      RC(2,7)   RC(2,8) RC(2,9) RC(2,10) RC(2,11) RC(2,12) RC(2,13)                RC(3,16)
      RC(3,0)     RC(3,1) RC(3,2) RC(3,3) RC(3,4)     RC(3,6)      RC(3,7)     RC(3,8) RC(3,9) RC(3,10) RC(3,11) RC(3,12) RC(3,13)    RC(3,14)   RC(4,16)
      RC(4,0) RC(4,1) RC(4,2) RC(4,3) RC(4,4) RC(4,5) RC(4,6)      RC(4,7)        RC(4,8) RC(4,9) RC(4,10)  RC(4,11)       RC(4,12)    RC(4,14) RC(4,15)
      RC(5,0)    RC(5,3)   RC(5,4)                    RC(5,6)      RC(5,7)                        RC(5,11)  RC(5,10)  RC(5,14) RC(5,9) RC(5,15) RC(5,16) 
    RC(6,0) RC(6,1) RC(6,2) RC(6,3) RC(6,4) RC(6,5) RC(6,6) RC(6,7) RC(6,8) RC(6,9) RC(6,10) RC(6,11) RC(6,12) RC(6,13) RC(6,14) RC(6,15) RC(6,16) RC(6,17) RC(6,18) RC(6,19) RC(6,20) RC(6,21) RC(6,22) RC(6,23) RC(6,24) RC(6,25) RC(6,26) RC(6,27) RC(6,28) RC(6,29) RC(6,30) RC(6,31) 
RC(7,0) RC(7,1) RC(7,2) RC(7,3) RC(7,4) RC(7,5) RC(7,6) RC(7,7) RC(7,8) RC(7,9) RC(7,10) RC(7,11) RC(7,12) RC(7,13) RC(7,14) RC(7,15) RC(7,16) RC(7,17) RC(7,18) RC(7,19) RC(7,20) RC(7,21) RC(7,22) RC(7,23) RC(7,24) RC(7,25) RC(7,26) RC(7,27) RC(7,28) RC(7,29) RC(7,30) RC(7,31) 
RC(8,0) RC(8,1) RC(8,2) RC(8,3) RC(8,4) RC(8,5) RC(8,6) RC(8,7) RC(8,8) RC(8,9) RC(8,10) RC(8,11) RC(8,12) RC(8,13) RC(8,14) RC(8,15) RC(8,16) RC(8,17) RC(8,18) RC(8,19) RC(8,20) RC(8,21) RC(8,22) RC(8,23) RC(8,24) RC(8,25) RC(8,26) RC(8,27) RC(8,28) RC(8,29) RC(8,30) RC(8,31) 
RC(9,0) RC(9,1) RC(9,2) RC(9,3) RC(9,4) RC(9,5) RC(9,6) RC(9,7) RC(9,8) RC(9,9) RC(9,10) RC(9,11) RC(9,12) RC(9,13) RC(9,14) RC(9,15) RC(9,16) RC(9,17) RC(9,18) RC(9,19) RC(9,20) RC(9,21) RC(9,22) RC(9,23) RC(9,24) RC(9,25) RC(9,26) RC(9,27) RC(9,28) RC(9,29) RC(9,30) RC(9,31) 
RC(10,0) RC(10,1) RC(10,2) RC(10,3) RC(10,4) RC(10,5) RC(10,6) RC(10,7) RC(10,8) RC(10,9) RC(10,10) RC(10,11) RC(10,12) RC(10,13) RC(10,14) RC(10,15) RC(10,16) RC(10,17) RC(10,18) RC(10,19) RC(10,20) RC(10,21) RC(10,22) RC(10,23) RC(10,24) RC(10,25) RC(10,26) RC(10,27) RC(10,28) RC(10,29) RC(10,30) RC(10,31) 
RC(11,0) RC(11,1) RC(11,2) RC(11,3) RC(11,4) RC(11,5) RC(11,6) RC(11,7) RC(11,8) RC(11,9) RC(11,10) RC(11,11) RC(11,12) RC(11,13) RC(11,14) RC(11,15) RC(11,16) RC(11,17) RC(11,18) RC(11,19) RC(11,20) RC(11,21) RC(11,22) RC(11,23) RC(11,24) RC(11,25) RC(11,26) RC(11,27) RC(11,28) RC(11,29) RC(11,30) RC(11,31) 
RC(12,0) RC(12,1) RC(12,2) RC(12,3) RC(12,4) RC(12,5) RC(12,6) RC(12,7) RC(12,8) RC(12,9) RC(12,10) RC(12,11) RC(12,12) RC(12,13) RC(12,14) RC(12,15) RC(12,16) RC(12,17) RC(12,18) RC(12,19) RC(12,20) RC(12,21) RC(12,22) RC(12,23) RC(12,24) RC(12,25) RC(12,26) RC(12,27) RC(12,28) RC(12,29) RC(12,30) RC(12,31) 
RC(13,0) RC(13,1) RC(13,2) RC(13,3) RC(13,4) RC(13,5) RC(13,6) RC(13,7) RC(13,8) RC(13,9) RC(13,10) RC(13,11) RC(13,12) RC(13,13) RC(13,14) RC(13,15) RC(13,16) RC(13,17) RC(13,18) RC(13,19) RC(13,20) RC(13,21) RC(13,22) RC(13,23) RC(13,24) RC(13,25) RC(13,26) RC(13,27) RC(13,28) RC(13,29) RC(13,30) RC(13,31) 
RC(14,0) RC(14,1) RC(14,2) RC(14,3) RC(14,4) RC(14,5) RC(14,6) RC(14,7) RC(14,8) RC(14,9) RC(14,10) RC(14,11) RC(14,12) RC(14,13) RC(14,14) RC(14,15) RC(14,16) RC(14,17) RC(14,18) RC(14,19) RC(14,20) RC(14,21) RC(14,22) RC(14,23) RC(14,24) RC(14,25) RC(14,26) RC(14,27) RC(14,28) RC(14,29) RC(14,30) RC(14,31) 
RC(15,0) RC(15,1) RC(15,2) RC(15,3) RC(15,4) RC(15,5) RC(15,6) RC(15,7) RC(15,8) RC(15,9) RC(15,10) RC(15,11) RC(15,12) RC(15,13) RC(15,14) RC(15,15) RC(15,16) RC(15,17) RC(15,18) RC(15,19) RC(15,20) RC(15,21) RC(15,22) RC(15,23) RC(15,24) RC(15,25) RC(15,26) RC(15,27) RC(15,28) RC(15,29) RC(15,30) RC(15,31) 
RC(16,0) RC(16,1) RC(16,2) RC(16,3) RC(16,4) RC(16,5) RC(16,6) RC(16,7) RC(16,8) RC(16,9) RC(16,10) RC(16,11) RC(16,12) RC(16,13) RC(16,14) RC(16,15) RC(16,16) RC(16,17) RC(16,18) RC(16,19) RC(16,20) RC(16,21) RC(16,22) RC(16,23) RC(16,24) RC(16,25) RC(16,26) RC(16,27) RC(16,28) RC(16,29) RC(16,30) RC(16,31) 
RC(17,0) RC(17,1) RC(17,2) RC(17,3) RC(17,4) RC(17,5) RC(17,6) RC(17,7) RC(17,8) RC(17,9) RC(17,10) RC(17,11) RC(17,12) RC(17,13) RC(17,14) RC(17,15) RC(17,16) RC(17,17) RC(17,18) RC(17,19) RC(17,20) RC(17,21) RC(17,22) RC(17,23) RC(17,24) RC(17,25) RC(17,26) RC(17,27) RC(17,28) RC(17,29) RC(17,30) RC(17,31) 

\
    >;
  };
};
## Kconfig
```kconfig
rsource "drivers/Kconfig"

menuconfig ZMK_STP_INDICATORS
    bool "STP Specific indicators"
    select LED_STRIP
    select ZMK_LOW_PRIORITY_WORK_QUEUE
    select ZMK_HID_INDICATORS

if ZMK_STP_INDICATORS

config SPI
    default y

config ZMK_STP_INDICATORS_KEYPAD
    bool "enable numpad specific LED code"

config ZMK_STP_INDICATORS_SWITCH_LEDS
    bool "Swap LED0 and LED1"

config ZMK_STP_INDICATORS_COLOR_CAPS
    bool "illuminate caps LED with profile LED color"

config ZMK_STP_INDICATORS_BRT_MAX
    int "RGB underglow maximum brightness in percent"
    range 0 100
    default 100

config ZMK_STP_INDICATORS_BATTERY_THRESHOLD
    int "When we decide battery low"
    range 0 100
    default 20

config ZMK_STP_INDICATORS_HIGHSEC
    bool "Enable high security mode LED indication"
    
endif
```

## boards/arm/mwave/Kconfig.board
```kconfig
# mWave board configuration

# Copyright (c) 2024 The ZMK Contributors
# SPDX-License-Identifier: MIT

config BOARD_MWAVE_33
    bool "mwave_33"
    depends on SOC_NRF52833_QIAA

config BOARD_MWAVENUMPAD
    bool "mwavenumpad"
    depends on SOC_NRF52833_QIAA
```

## boards/arm/mwave/Kconfig.defconfig
```kconfig
# Copyright (c) 2024 The ZMK Contributors
# SPDX-License-Identifier: MIT

config BOARD
    default "mwave_33" if BOARD_MWAVE_33
    default "mwavenumpad" if BOARD_MWAVENUMPAD
    
config ZMK_KEYBOARD_NAME
    default "mWave"

config ZMK_BLE
    default y

if BOARD_MWAVE_33 || BOARD_MWAVENUMPAD

if USB

config USB_NRFX
    default y

config USB_DEVICE_STACK
    default y

endif # USB

config BT_CTLR
    default BT

if ZMK_STUDIO

config ZMK_STUDIO_RPC_RX_BUF_SIZE
    default 128

config ZMK_STUDIO_RPC_TX_BUF_SIZE
    default 256

endif

if ZMK_BLE

config ZMK_BLE_EXPERIMENTAL_CONN
    default y

choice BT_CTLR_TX_PWR
    default BT_CTLR_TX_PWR_PLUS_8
endchoice

config BT_DIS_MANUF
    select "Kinesis Corporation"

config BT_DIS_PNP_VID
    select 0x29EA

config BT_DIS_PNP_PID
    select 0x1001

config BT_MAX_CONN
    default 2

config BT_MAX_PAIRED
    default 2

endif # ZMK_BLE

endif # BOARD_MWAVE_33 || BOARD_MWAVENUMPAD
```

## boards/arm/mwave/mwave_33_defconfig
```kconfig
# SPDX-License-Identifier: MIT

CONFIG_SOC_SERIES_NRF52X=y
CONFIG_SOC_NRF52833_QIAA=y
CONFIG_BOARD_MWAVE_33=y

# Pin Configuration
CONFIG_GPIO=y
CONFIG_SPI=y
CONFIG_PINCTRL=y

# BT configuration
CONFIG_ZMK_BLE=y
CONFIG_ZMK_BLE_EXPERIMENTAL_CONN=y
CONFIG_BT_CTLR_TX_PWR_PLUS_8=y
CONFIG_BT_DIS_MANUF="Kinesis Corporation"
CONFIG_BT_DIS_PNP_VID=0x29EA
CONFIG_BT_DIS_PNP_PID=0x1001
CONFIG_BT_MAX_CONN=2
CONFIG_BT_MAX_PAIRED=2

# USB configuration
CONFIG_ZMK_USB=y
CONFIG_USB_DEVICE_VID=0x29EA
CONFIG_USB_DEVICE_PID=0x1001
CONFIG_USB_DEVICE_MANUFACTURER="Kinesis Corporation"


# Flash configuration
CONFIG_ARM_MPU=y
CONFIG_MPU_ALLOW_FLASH_WRITE=y
CONFIG_NVS=y
CONFIG_SETTINGS_NVS=y
CONFIG_FLASH=y
CONFIG_FLASH_PAGE_LAYOUT=y
CONFIG_FLASH_MAP=y
CONFIG_USE_DT_CODE_PARTITION=y
CONFIG_BUILD_OUTPUT_UF2=y

# Enable 32k xtal
CONFIG_CLOCK_CONTROL_NRF=y
CONFIG_CLOCK_CONTROL_NRF_K32SRC_XTAL=y
CONFIG_CLOCK_CONTROL_NRF_K32SRC_150PPM=y

# Lighting configuration
CONFIG_PWM=y
CONFIG_LED_PWM=y
CONFIG_ZMK_BACKLIGHT=y
CONFIG_ZMK_BACKLIGHT_BRT_STEP=34
CONFIG_ZMK_STP_INDICATORS=y

CONFIG_ZMK_ENDPOINT_DISABLE_FALLBACK=y

CONFIG_ZMK_BEHAVIORS_QUEUE_SIZE=128

CONFIG_ZMK_POINTING=y


CONFIG_ZMK_KSCAN_DEBOUNCE_PRESS_MS=15
CONFIG_ZMK_KSCAN_DEBOUNCE_RELEASE_MS=15
```

## boards/arm/mwave/mwavetest_20_defconfig
```kconfig
# SPDX-License-Identifier: MIT

CONFIG_SOC_SERIES_NRF52X=y
CONFIG_SOC_NRF52820_QDAA=y
CONFIG_BOARD_MWAVETEST_20=y

# Enable MPU
CONFIG_ARM_MPU=y

CONFIG_PINCTRL=y

# enable GPIO
CONFIG_GPIO=y
CONFIG_SPI=y

CONFIG_USE_DT_CODE_PARTITION=y
#CONFIG_BUILD_OUTPUT_HEX=y

CONFIG_MPU_ALLOW_FLASH_WRITE=y
CONFIG_NVS=y
CONFIG_SETTINGS_NVS=y
CONFIG_FLASH=y
CONFIG_FLASH_PAGE_LAYOUT=y
CONFIG_FLASH_MAP=y
CONFIG_CLOCK_CONTROL_NRF=y
CONFIG_CLOCK_CONTROL_NRF_K32SRC_XTAL=n
CONFIG_CLOCK_CONTROL_NRF_K32SRC_RC=y

CONFIG_ZMK_BACKLIGHT=y
CONFIG_ZMK_BACKLIGHT_BRT_START=100
CONFIG_ZMK_STP_INDICATORS=n
CONFIG_ZMK_STP_INDICATORS_EXT_POWER=n

CONFIG_ZMK_BEHAVIORS_QUEUE_SIZE=11


# ZMK
## we don't have battery reporting (yet or maybe never)
CONFIG_ZMK_BATTERY_REPORTING=n
CONFIG_ZMK_EXT_POWER=n

# optimizations for RAM
#CONFIG_HEAP_MEM_POOL_SIZE=1024
CONFIG_SYSTEM_WORKQUEUE_STACK_SIZE=1536
#CONFIG_ZMK_LOW_PRIORITY_THREAD_STACK_SIZE=256
CONFIG_ZMK_BLE_CONSUMER_REPORT_QUEUE_SIZE=3
CONFIG_ZMK_BLE_KEYBOARD_REPORT_QUEUE_SIZE=15


# # limit number of connections
CONFIG_BT_MAX_CONN=1
CONFIG_BT_MAX_PAIRED=1
# 
# # optimizations for ROM
CONFIG_SIZE_OPTIMIZATIONS=y
CONFIG_DEBUG_OPTIMIZATIONS=n
# 
# # debug
CONFIG_LOG=n
CONFIG_DEBUG=n
CONFIG_ASSERT=n
CONFIG_USE_SEGGER_RTT=n
CONFIG_RTT_CONSOLE=n
CONFIG_LOG_BACKEND_RTT=n
CONFIG_PRINTK=n
# 
# 
# # # Disable features not needed
CONFIG_TIMESLICING=n
CONFIG_MINIMAL_LIBC_MALLOC=n
# 
# # # Disable Bluetooth features not needed
CONFIG_BT_DEBUG_NONE=y
CONFIG_BT_ASSERT=n
CONFIG_BT_DATA_LEN_UPDATE=n
CONFIG_BT_PHY_UPDATE=n
CONFIG_BT_GATT_CACHING=n
CONFIG_BT_GATT_SERVICE_CHANGED=n
CONFIG_BT_GAP_PERIPHERAL_PREF_PARAMS=n
CONFIG_BT_SETTINGS_CCC_LAZY_LOADING=y
CONFIG_BT_HCI_VS_EXT=n
# 
# # # Disable Bluetooth controller features not needed
CONFIG_BT_CTLR_PRIVACY=n
CONFIG_BT_CTLR_PHY_2M=n
# 
# # # Reduce Bluetooth buffers
CONFIG_BT_BUF_EVT_DISCARDABLE_COUNT=1
CONFIG_BT_BUF_EVT_DISCARDABLE_SIZE=43
CONFIG_BT_BUF_EVT_RX_COUNT=2
CONFIG_BT_CONN_TX_MAX=2
CONFIG_BT_L2CAP_TX_BUF_COUNT=2
CONFIG_BT_BUF_ACL_TX_COUNT=3
CONFIG_BT_BUF_ACL_TX_SIZE=27
CONFIG_BT_RX_STACK_SIZE=1500
# 

CONFIG_ZMK_USB=n
CONFIG_ZMK_BLE=y
```

## boards/arm/mwave/mwavetest_33_defconfig
```kconfig
# SPDX-License-Identifier: MIT

CONFIG_SOC_SERIES_NRF52X=y
CONFIG_SOC_NRF52833_QIAA=y
CONFIG_BOARD_MWAVETEST_33=y

# Enable MPU
CONFIG_ARM_MPU=y

CONFIG_PINCTRL=y

# enable GPIO
CONFIG_GPIO=y
CONFIG_SPI=y

CONFIG_USE_DT_CODE_PARTITION=y
CONFIG_BUILD_OUTPUT_UF2=y

CONFIG_MPU_ALLOW_FLASH_WRITE=y
CONFIG_NVS=y
CONFIG_SETTINGS_NVS=y
CONFIG_FLASH=y
CONFIG_FLASH_PAGE_LAYOUT=y
CONFIG_FLASH_MAP=y
CONFIG_CLOCK_CONTROL_NRF=y
CONFIG_CLOCK_CONTROL_NRF_K32SRC_XTAL=y

CONFIG_PWM=y
CONFIG_LED_PWM=y
CONFIG_ZMK_BACKLIGHT=y

CONFIG_ZMK_RGB_UNDERGLOW=y
CONFIG_ZMK_RGB_UNDERGLOW_EXT_POWER=y
CONFIG_ZMK_RGB_UNDERGLOW_ON_START=y
CONFIG_ZMK_RGB_UNDERGLOW_HUE_START=0

CONFIG_ZMK_USB=y
CONFIG_ZMK_BLE=y
```

## config/west.yml
```yaml
manifest:
  remotes:
    - name: petejohanson
      url-base: https://github.com/petejohanson
    - name: refil
      url-base: https://github.com/ReFil
    # Additional modules containing boards/shields/custom code can be listed here as well
    # See https://docs.zephyrproject.org/3.2.0/develop/west/manifest.html#projects
  projects:
    - name: zmk
      remote: refil
      revision: kssbtest
      import: app/west.yml
    - name: gpio-rgb-zephyr-module
      remote: refil
      revision: main
  self:
    path: config
```

## drivers/sensor/battery/Kconfig
```kconfig
# Copyright (c) 2020-2021 The ZMK Contributors
# SPDX-License-Identifier: MIT

DT_COMPAT_KINESIS_BATTERY_VOLTAGE_DIVIDER := kinesis,battery-voltage-divider

config KINESIS_BATTERY
    bool "KINESIS battery monitoring"
    help
        Enable battery monitoring

config KINESIS_BATTERY_VOLTAGE_DIVIDER
    bool
    default $(dt_compat_enabled,$(DT_COMPAT_KINESIS_BATTERY_VOLTAGE_DIVIDER))
    select ADC
    select KINESIS_BATTERY
    depends on SENSOR
    help
        Enable KINESIS battery voltage divider driver for battery monitoring.
```

## dts/bindings/behaviors/zmk,behavior-advertising-mode.yaml
```yaml
# Copyright (c) 2024 Polarity Works
# SPDX-License-Identifier: MIT

description: Advertising mode set

compatible: "zmk,behavior-advertising-mode"

include: one_param.yaml
```

## dts/bindings/sensor/kinesis,battery-voltage-divider.yaml
```yaml
# Copyright (c) 2020 The ZMK Contributors
# SPDX-License-Identifier: MIT

description: Battery SoC monitoring using voltage divider

compatible: "kinesis,battery-voltage-divider"

include: voltage-divider.yaml
```
